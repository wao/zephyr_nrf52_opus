## CMakeLists.txt
```
cmake_minimum_required(VERSION 3.8.2)
set_property(GLOBAL PROPERTY CSTD c11)


include($ENV{ZEPHYR_BASE}/cmake/app/boilerplate.cmake NO_POLICY_SCOPE)
project(otg2)

enable_language(C ASM)

set(CMAKE_C_FLAGS "${CMAKE_C_FLAGS} \
 -DARM_MATH_CM4 \
 -DDISABLE_FLOAT_API \
 -DFIXED_POINT \
 -DUSE_ALLOCA \
 -DHAVE_LRINT \
 -DHAVE_LRINTF \
 -DOPUS_ARM_ASM \
 -DOPUS_ARM_INLINE_EDSP \
 -DOPUS_ARM_INLINE_MEDIA \
 -DOPUS_ARM_MAY_HAVE_EDSP \
 -DOPUS_ARM_PRESUME_EDSP \
 -DCUSTOM_SUPPORT \
 -DVAR_ARRAYS \
 -DOPUS_BUILD \
 -DHAVE_CONFIG_H \
 -D_errata_191_ \
 -g \
")
# -DNOGUI \
# -DOVERRIDE_OPUS_ALLOC -DOVERRIDE_OPUS_FREE -D'opus_alloc(x)=NULL' -D'opus_free(x)=NULL' \

# Use DOPUS_ARM_INLINE_EDSP instead of
# -DOPUS_ARM_INLINE_ASM \

# Not if use minimal lib
# -DHAVE_ALLOCA_H \



target_sources(                     app PRIVATE src/main.c)
target_sources(                     app PRIVATE src/clock.c)
#target_sources(                     app PRIVATE src/user_led.c)


if(DEFINED CONFIG_AUDIO_CODEC_SGTL5000)
	FILE(GLOB_RECURSE audio_sources src/audio/*.c)
	FILE(GLOB_RECURSE radio_sources src/radio/*.c)
endif()


if(DEFINED CONFIG_DISPLAY)
	FILE(GLOB_RECURSE display_sources src/display/*.c)
	FILE(GLOB_RECURSE ihm_sources src/gui/*.c)
endif()

if(DEFINED CONFIG_FILE_SYSTEM)
	FILE(GLOB_RECURSE storage_sources src/storage/*.c)
endif()

FILE(GLOB_RECURSE stat_sources src/statistic/*.c)


FILE(GLOB_RECURSE opus_celt lib/opus-1.2.1/celt/*.c)
FILE(GLOB_RECURSE opus_src lib/opus-1.2.1/src/*.c)
target_sources(app PRIVATE
	${opus_celt}
	${opus_src}
	lib/opus-1.2.1/celt/arm/celt_pitch_xcorr_arm_gcc.s
	lib/opus-1.2.1/silk/biquad_alt.c
	lib/opus-1.2.1/silk/lin2log.c
	lib/opus-1.2.1/silk/log2lin.c
	)

#FILE(GLOB_RECURSE nordic_source modules/hal/nordic/nrfx/drivers/src/*.c)


target_sources(app PRIVATE
	${audio_sources}
	${radio_sources}
	${display_sources}
	${ihm_sources}
	${storage_sources}
	${stat_sources}
	${nordic_source}
	)

zephyr_include_directories(
	src/
	src/audio/
	lib/opus-1.2.1/include
	lib/opus-1.2.1/silk/	
	lib/opus-1.2.1/silk/fixed
	lib/opus-1.2.1/celt
	lib/opus-1.2.1/src
	src/audio/sgtl5000/
	src/radio/
	src/display/
	src/gui/
	src/storage/
	src/stat/
	)
	
	
	
#set(CMAKE_C_FLAGS "${CMAKE_C_FLAGS} \
# -DUSE_LV_DEMO \
#")
```

## prj.conf
```kconfig
CONFIG_SYS_CLOCK_TICKS_PER_SEC=1000


# Kernel options
CONFIG_ENTROPY_GENERATOR=y
CONFIG_INIT_STACKS=y

#
# ARM Options
#


#
# ARM Cortex-M0/M0+/M3/M4/M7/M23/M33 options
#
CONFIG_MPU_STACK_GUARD=y


#
# General Architecture Options
#

CONFIG_HW_STACK_PROTECTION=y

#
# Bluetooth
#
# CONFIG_BT is not set

#
# General Kernel Options
#
CONFIG_MAIN_STACK_SIZE=4048

#
# Kernel Debugging and Metrics
#
CONFIG_THREAD_MONITOR=y
CONFIG_THREAD_NAME=y

#
# Shell Options
#
CONFIG_SHELL=y
#CONFIG_SHELL_BACKENDS=y
#CONFIG_SHELL_BACKEND_SERIAL=y

#CONFIG_SHELL_CMDS=y
#CONFIG_SHELL_CMDS_RESIZE=y
#CONFIG_SHELL_LOG_BACKEND=y
CONFIG_KERNEL_SHELL=y
CONFIG_DEVICE_SHELL=y


#
# C Library
#
CONFIG_NEWLIB_LIBC=y
CONFIG_STDOUT_CONSOLE=y

#
# Logging Options
#
CONFIG_LOG=y
CONFIG_LOG_BUFFER_SIZE=2048

#
# Debugging Options
#
CONFIG_DEBUG=y
CONFIG_STACK_USAGE=y
CONFIG_STACK_SENTINEL=y
CONFIG_PRINTK=y
CONFIG_ASSERT=y
CONFIG_ASSERT_LEVEL=2

#
# Compiler Options
#
#CONFIG_SIZE_OPTIMIZATIONS=y
#CONFIG_SPEED_OPTIMIZATIONS=y
CONFIG_DEBUG_OPTIMIZATIONS=y
#CONFIG_COMPILER_OPT="-g"
```

## src/main.c
```c
/*
 * main.c
 *
 *  Created on: 12 mars 2019
 *      Author: nlantz
 */


#include <zephyr/kernel.h>
#include <stdio.h>
#include <version.h>

#include <zephyr/logging/log.h>
LOG_MODULE_REGISTER(main, LOG_LEVEL_DBG);

#ifdef CONFIG_AUDIO_CODEC_SGTL5000
#define AUDIO 1
#define RADIO 1
#endif

static struct k_sem quit_lock;

void quit(void)
{
	LOG_ERR("quit");
	k_sem_give(&quit_lock);
}


void panic(const char *msg)
{
	if (msg) {
		LOG_ERR("%s", msg);
	}

	for (;;) {
		k_sleep(K_FOREVER);
	}
}


/****************************************************************/
extern int storage_Init (void);

int main(void)
{
#if 0
	LOG_INF("-- Zephyr:\t %s ",KERNEL_VERSION_STRING);
	LOG_INF("-- Board:\t %s", CONFIG_BOARD);
	LOG_INF("-- Compiled:\t %s %s", __DATE__, __TIME__);
	LOG_INF("Starting...");

	Led_Init();

	k_sem_init(&quit_lock, 0, UINT_MAX);

#if CONFIG_DISPLAY
	gui_preload();
#endif

#if RADIO
	//Init Radio Interface
	radio_Init();
#endif

#if AUDIO
	audio_server_init();
#endif

#if CONFIG_FILE_SYSTEM
	storage_Init();
#endif

	//Set Mode
	radio_mode_select(MODE_IDLE);
	//
    //shell_execute_cmd(NULL, "go");

#if CONFIG_DISPLAY
	gui_load();
#endif

	LOG_INF("wait App End...");
	k_sem_take(&quit_lock, K_FOREVER);
	LOG_INF("Stopping...");

#if AUDIO
	audio_server_stop();
#endif
#endif
  return 0;
}

#if 0
#include <shell/shell.h>
#include <version.h>


static int cmd_version(const struct shell *shell, size_t argc, char **argv)
{
	ARG_UNUSED(argc);
	ARG_UNUSED(argv);

	shell_print(shell, "Zephyr version %s", KERNEL_VERSION_STRING);

	return 0;
}


SHELL_CMD_ARG_REGISTER(version, NULL, "Show kernel version", cmd_version, 1, 0);


#endif
```

## src/clock.c
```c
/*
 * clock.c
 *
 *  Created on: 1 avr. 2019
 *      Author: nlantz
 */


#if 0
#include <errno.h>
#include <zephyr/types.h>
#include <zephyr/drivers/clock_control/nrf_clock_control.h>


#define DEBUG_RADIO_XTAL(flag)



static struct {
	struct device *clk_hf;
} clk;



int clk_init(void)
{
	struct device *clk_k32;
	//int err;

	/* Initialize LF CLK */
	clk_k32 = device_get_binding(DT_INST_0_NORDIC_NRF_CLOCK_LABEL "_32K");
	if (!clk_k32) {
		return -ENODEV;
	}

	clock_control_on(clk_k32, (void *)CLOCK_CONTROL_NRF_K32SRC);

	/* Initialize HF CLK */
	clk.clk_hf =
		device_get_binding(DT_INST_0_NORDIC_NRF_CLOCK_LABEL "_16M");
	if (!clk.clk_hf) {
		return -ENODEV;
	}

	return 0;
}




int clk_on(void)
{
	int err;

	/* turn on radio clock in non-blocking mode. */
	err = clock_control_on(clk.clk_hf, NULL);
	if (!err || err == -EINPROGRESS) {
		DEBUG_RADIO_XTAL(1);
	}

	return err;
}

int clk_on_wait(void)
{
	int err;

	/* turn on radio clock in blocking mode. */
	err = clock_control_on(clk.clk_hf, (void *)1);
	if (!err || err == -EINPROGRESS) {
		DEBUG_RADIO_XTAL(1);
	}

	return err;
}

int clk_off(void)
{
	int err;

	/* turn off radio clock in non-blocking mode. */
	err = clock_control_off(clk.clk_hf, NULL);
	if (!err) {
		DEBUG_RADIO_XTAL(0);
	} else if (err == -EBUSY) {
		DEBUG_RADIO_XTAL(1);
	}

	return err;
}

#endif
```
